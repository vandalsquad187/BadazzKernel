/* Copyright (c) 2018, The Linux Foundation. All rights reserved.
 * Copyright (C) 2021 XiaoMi, Inc.
 *
 * This program is free software; you can redistribute it and/or modify
 * it under the terms of the GNU General Public License version 2 and
 * only version 2 as published by the Free Software Foundation.
 *
 * This program is distributed in the hope that it will be useful,
 * but WITHOUT ANY WARRANTY; without even the implied warranty of
 * MERCHANTABILITY or FITNESS FOR A PARTICULAR PURPOSE.  See the
 * GNU General Public License for more details.
 */

/dts-v1/;
/plugin/;

#include <dt-bindings/interrupt-controller/arm-gic.h>
#include <dt-bindings/clock/qcom,camcc-sdmmagpie.h>

#include "xiaomi/sweet/sweet-audio-overlay.dtsi"
#include "xiaomi/sweet/sweet-sdmmagpie.dtsi"
#include "xiaomi/sweet/sweet-nfc-overlay.dtsi"

/ {
	model = "SWEET";
	compatible = "qcom,sdmmagpie-qrd", "qcom,sdmmagpie", "qcom,qrd";
	qcom,msm-id = <365 0x0>;
	qcom,board-id = <46 0>;
};

// pstore/ramoops backend for crash logs (matches stock 0xb0000000+4M reservation)
// NOTE: reg uses parent 2+2 cells, but *-size are plain u32 scalars (single cell)!
&reserved_memory {
	ramoops@b0000000 {
		compatible = "ramoops";
		reg = <0x0 0xb0000000 0x0 0x400000>;
		record-size = <0x20000>;
		console-size = <0x20000>;
		ftrace-size = <0x20000>;
		pmsg-size = <0x20000>;
	};
};
